/*
 * SPDX-License-Identifier: GPL-2.0-or-later
 */

/dts-v1/;
 
#include "msm8953-qrd-sku3-tissot.dtsi"

&firmware {
	android {
		fstab {
			vendor {
				fsmgr_flags = "wait,slotselect";
				status = "ok";
			};
		};
	};
};
